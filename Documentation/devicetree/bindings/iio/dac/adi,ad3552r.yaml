## Documentation/devicetree/bindings/iio/dac/adi,ad3552r.yaml
```yaml
# SPDX-License-Identifier: (GPL-2.0 OR BSD-2-Clause)
# Copyright 2020 Analog Devices Inc.
%YAML 1.2
---
$id: http://devicetree.org/schemas/iio/dac/adi,ad3552r.yaml#
$schema: http://devicetree.org/meta-schemas/core.yaml#

title: Analog Devices AD2552R DAC device driver

maintainers:
  - Mihail Chindris <mihail.chindris@analog.com>

description: |
  Bindings for the Analog Devices AD3552R  DAC device. Datasheet can be
  found here:
    https://www.analog.com/media/en/technical-documentation/data-sheets/ad3552r.pdf

properties:
  compatible:
    enum:
      - adi,ad3552r

  reg:
    maxItems: 1

  spi-max-frequency:
    maximum: 30000000

  interrupts:
    maxItems: 1
    description: Interrupt for trigger

  adi,vref-select:
    description: Selection of the voltage reference.
      The options are
       - 0 internal source with Vref I/O floating
       - 1 internal source with Vref I/O at 2.5V.
       - 2 external source with Vref I/O as input.
    $ref: /schemas/types.yaml#/definitions/uint32
    enum: [0, 1, 2]

  reset-gpios:
    description: GPIO spec for the RESET pin. If specified, it will be
      asserted during driver probe.
    maxItems: 1

  crc-en:
    description: Enable or disable crc
    type: boolean

  spi-multi-io-mode:
    enum:
      - standard
      - dual
      - quad
    description: Select SPI operating mode
    default: standard

  ddr:
    description: Enable or disable double data rate SPI
    type: boolean
    default: false

  synchronous-mode:
    description: Enable or disable synchronous dual SPI mode
    type: boolean
    default: false

  pwms:
    description: PWM used as LDAC signal and for generating interrupts for sampling
    maxItems: 1

patternProperties:
  "^channel@([0-1])$":
    type: object
    description: Configurations of the DAC Channels
    properties:
      num:
          description: Channel number
          $ref: /schemas/types.yaml#/definitions/uint32
          minimum: 0
          maximum: 1
      adi,dac-powerdown:
        type: boolean
        description: Powerdown internal DAC

      adi,output-range:
        description: |
          Output range of the channel
            0: 0 V to 2.5 V
            1: 0 V to 5 V
            2: 0 V to 10 V
            3: -5 V to 5 V
            4: -10 V to 10 V
        $ref: /schemas/types.yaml#/definitions/uint32
        enum: [0, 1, 2, 3, 4]

      custom-output-range-config:
        type: object
        description: Configuration of custom range when adi,output-range is set
                      to custom
        properties:
          adi,gain-offset:
            description: Gain offset
            $ref: "/schemas/types.yaml#/definitions/int32"
            maximum: 511
            minimum: -511
          adi,gain-sacling-p:
            description: |
              Scaling p:
               0: 1.0
               1: 0.5
               2: 0.25
               3: 0.125
            $ref: /schemas/types.yaml#/definitions/uint32
            enum: [0, 1, 2, 3]
          adi,gain-sacling-n:
            description: |
              Scaling p:
               0: 1.0
               1: 0.5
               2: 0.25
               3: 0.125
            $ref: /schemas/types.yaml#/definitions/uint32
            enum: [0, 1, 2, 3]
          adi,rfb:
            description: Feedback Resistor
            $ref: /schemas/types.yaml#/definitions/uint32
        required:
          - adi,gain-offset
          - adi,gain-sacling-p
          - adi,gain-sacling-n
          - adi,rfb
    required:
      - num

    allOf:
      # If adi,output-range is missing, custom-output-range-config must be used
      - if:
          required:
          - adi,output-range
        else:
          required:
          - custom-output-range-config

required:
  - compatible
  - reg
  - spi-max-frequency
  - channel@0
  - channel@1

additionalProperties: false

examples:
  - |
    ad3552r {
      compatible = "adi,ad3552r";
      reg = <0 0 0 0>;
      spi-max-frequency = <20000000>;
      interrupt-parent = <&gpio0>;
      interrupts = <87 0>;
      pwms = <&axi_pwm 0 50>;
      reset-gpios = <&gpio 86 0>;
      adi,vref-select = <0>;
      ch0: channel@0 {
        num = <0>;
        adi,output-range = <0>;
      };
      ch1: channel@1 {
        num = <1>;
        custom-output-range-config {
          adi,gain-offset = <5>;
          adi,gain-sacling-p = <1>;
          adi,gain-sacling-n = <2>;
          adi,rfb = <1>;
        };
      };
    };
...
```
